/**********************************包含头文件**********************************/
#include "lcd12864.h"


/*******************************************************************************
* 函 数 名         : Lcd12864_Delay1ms
* 函数功能		   : 延时函数，延时1ms
* 输    入         : c
* 输    出         : 无
* 说    名         : 该函数是在11.0592MHZ晶振下，12分频单片机的延时。
*******************************************************************************/
/* 延时函数 */
void Lcd12864_Delay1ms(uint c)   //误差 0us
{
  uchar a,b;
	for (; c>0; c--)
	{
		 for (b=199;b>0;b--)
		 {
		  	for(a=1;a>0;a--);
		 }      
	}
    	
}

/*******************************************************************************
* 函 数 名         : LcdWriteCom
* 函数功能		   : 向LCD写入一个字节的命令
* 输    入         : com
* 输    出         : 无
*******************************************************************************/
void LcdWriteCom(uchar com)	  //写入命令
{
	LCD12864_E = 0;     //使能
	LCD12864_RS = 0;	   //选择发送命令
	LCD12864_RW = 0;	   //选择写入
	
	LCD12864_DATAPINS = com;     //放入命令
	Lcd12864_Delay1ms(1);		//等待数据稳定

	LCD12864_E = 1;	          //写入时序
	Lcd12864_Delay1ms(5);	  //保持时间
	LCD12864_E = 0;
}
/*******************************************************************************
* 函 数 名         : LcdWriteData
* 函数功能		   : 向LCD写入一个字节的数据
* 输    入         : dat
* 输    出         : 无
*******************************************************************************/		      
void LcdWriteData(uchar dat)			//写入数据
{
	LCD12864_E = 0;	//使能清零
	LCD12864_RS = 1;	//选择输入数据
	LCD12864_RW = 0;	//选择写入

	LCD12864_DATAPINS = dat; //写入数据
	Lcd12864_Delay1ms(1);

	LCD12864_E = 1;   //写入时序
	Lcd12864_Delay1ms(5);   //保持时间
	LCD12864_E = 0;
}
//=========================================================================================

/* 指定位置显示字符串 注意 (1/4 0-16，"显示字符串") */
void wri_string(uchar y,uchar x,uchar a[])
{
	uchar i;
	if(y==1)//如果选择第1行
		LcdWriteCom(0x80+x);//选中地址
	if(y==2)//如果选择第2行
		LcdWriteCom(0x90+x);//选中地址
	if(y==3)//如果选择第3行
		LcdWriteCom(0x88+x);//选中地址
	if(y==4)//如果选择第4行
		LcdWriteCom(0x98+x);//选中地址
		for(i=0;a[i]!='\0';i++)
		{
			LcdWriteData(a[i]);
		}
}



/*******************************************************************************
* 函 数 名       : LcdInit()
* 函数功能		 : 初始化LCD屏
* 输    入       : 无
* 输    出       : 无
*******************************************************************************/		   
void LcdInit()						  //LCD初始化子程序
{
 	LcdWriteCom(0x34);  //开显示
	LcdWriteCom(0x30);  //开显示不显示光标
	LcdWriteCom(0x0c);  //写一个指针加1
	LcdWriteCom(0x01);  //清屏
}

/*******************************************************************************
* 函 数 名         : lcd_write_char
* 函数功能		   	:
* 输    入         :
* 输    出         : 无
*******************************************************************************/
void lcd_write_char(uchar y, uchar x, uchar dat) //列x=0~15,行y=0,1
{
	unsigned char temp_l, temp_h;
	if(y==1)//如果选择第1行
		LcdWriteCom(0x80+x);//选中地址
	if(y==2)//如果选择第2行
		LcdWriteCom(0x90+x);//选中地址
	if(y==3)//如果选择第3行
		LcdWriteCom(0x88+x);//选中地址
	if(y==4)//如果选择第4行
		LcdWriteCom(0x98+x);//选中地址
		temp_l = dat % 10;
    temp_h = dat / 10;
    LcdWriteData(temp_h + 0x30);          
    LcdWriteData(temp_l + 0x30);
}